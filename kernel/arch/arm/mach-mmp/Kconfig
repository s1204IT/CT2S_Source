## kernel/arch/arm/mach-mmp/Kconfig
```kconfig
if ARCH_MMP

menu "Marvell PXA168/910/MMP2 Implmentations"

config MACH_ASPENITE
	bool "Marvell's PXA168 Aspenite Development Board"
	select CPU_PXA168
	help
	  Say 'Y' here if you want to support the Marvell PXA168-based
	  Aspenite Development Board.

config MACH_ZYLONITE2
	bool "Marvell's PXA168 Zylonite2 Development Board"
	select CPU_PXA168
	help
	  Say 'Y' here if you want to support the Marvell PXA168-based
	  Zylonite2 Development Board.

config MACH_AVENGERS_LITE
	bool "Marvell's PXA168 Avengers Lite Development Board"
	select CPU_PXA168
	help
	  Say 'Y' here if you want to support the Marvell PXA168-based
	  Avengers Lite Development Board.

config MACH_TAVOREVB
	bool "Marvell's PXA910 TavorEVB Development Board"
	select CPU_PXA910
	help
	  Say 'Y' here if you want to support the Marvell PXA910-based
	  TavorEVB Development Board.

config MACH_TTC_DKB
	bool "Marvell's PXA910 TavorEVB Development Board"
	select CPU_PXA910
	help
	  Say 'Y' here if you want to support the Marvell PXA910-based
	  TTC_DKB Development Board.

config MACH_BROWNSTONE
	bool "Marvell's Brownstone Development Platform"
	depends on !CPU_MOHAWK
	select CPU_MMP2
	help
	  Say 'Y' here if you want to support the Marvell MMP2-based
	  Brown Development Platform.
	  MMP2-based board can't be co-existed with PXA168-based &
	  PXA910-based development board. Since MMP2 is compatible to
	  ARMv7 architecture.

config MACH_FLINT
	bool "Marvell's Flint Development Platform"
	depends on !CPU_MOHAWK
	select CPU_MMP2
	help
	  Say 'Y' here if you want to support the Marvell MMP2-based
	  Flint Development Platform.
	  MMP2-based board can't be co-existed with PXA168-based &
	  PXA910-based development board. Since MMP2 is compatible to
	  ARMv7 architecture.

config MACH_MARVELL_JASPER
	bool "Marvell's Jasper Development Platform"
	depends on !CPU_MOHAWK
	select CPU_MMP2
	help
	  Say 'Y' here if you want to support the Marvell MMP2-base
	  Jasper Development Platform.
	  MMP2-based board can't be co-existed with PXA168-based &
	  PXA910-based development board. Since MMP2 is compatible to
	  ARMv7 architecture.

config MACH_TETON_BGA
	bool "Marvell's PXA168 Teton BGA Development Board"
	select CPU_PXA168
	help
	  Say 'Y' here if you want to support the Marvell PXA168-based
	  Teton BGA Development Board.

config MACH_GPLUGD
	bool "Marvell's PXA168 GuruPlug Display (gplugD) Board"
	select CPU_PXA168
	help
	  Say 'Y' here if you want to support the Marvell PXA168-based
	  GuruPlug Display (gplugD) Board

config MACH_MMP_DT
	bool "Support MMP (ARMv5) platforms from device tree"
	select CPU_PXA168
	select CPU_PXA910
	select USE_OF
	select PINCTRL
	select PINCTRL_SINGLE
	help
	  Include support for Marvell MMP2 based platforms using
	  the device tree. Needn't select any other machine while
	  MACH_MMP_DT is enabled.

config MACH_MMP2_DT
	bool "Support MMP2 (ARMv7) platforms from device tree"
	depends on !CPU_MOHAWK
	select CPU_MMP2
	select USE_OF
	select PINCTRL
	select PINCTRL_SINGLE
	help
	  Include support for Marvell MMP2 based platforms using
	  the device tree.

config MACH_MMPX_DT
	bool "Support no-PJ/PJ4(ARMv7) platforms from device tree"
	depends on !CPU_MOHAWK && !CPU_PJ4
	select CPU_PXA988
	select USE_OF
	select PINCTRL
	select PINCTRL_SINGLE
	help
	  Include support for Marvell MMP2 based platforms using
	  the device tree.

config MACH_PXA1928_DT
	bool "Support PXA1928(ARMv7) platforms from device tree"
	depends on !CPU_MOHAWK && !CPU_PJ4
	select CPU_PXA1928
	select CLKSRC_OF
	select USE_OF
	select PINCTRL
	select PINCTRL_SINGLE
	help
	  Include support for Marvell PXA1928 based platforms using
	  the device tree.

config MACH_ADIR_DT
	bool "Support Adir(ARMv7) platforms from device tree"
	depends on !CPU_MOHAWK && !CPU_PJ4
	select CPU_PXA1986
	select USE_OF
	help
	  Include support for Marvell PXA1986 SoC based
	  using the device tree.

config MACH_SOC_CAMERA_DKB
	bool "Support soc camera support on pxa1x88 dkb platform"
	depends on !CPU_MOHAWK && !CPU_PJ4
	select MACH_MMPX_DT
	help
	  Include support all smart sensor power sequence on Marvell
	  platforms using the device tree.

config MACH_SOC_CAMERA_FF
	bool "Support soc camera support on pxa1x88 FF platform"
	depends on !CPU_MOHAWK && !CPU_PJ4
	select MACH_MMPX_DT
	help
	  Include support all smart sensor power sequence on Marvell
	  platforms using the device tree.

config MACH_SOC_CAMERA_L7
	bool "Support soc camera support on L7 platform"
	depends on !CPU_MOHAWK && !CPU_PJ4
	select MACH_MMPX_DT
	help
	  Include support all smart sensor power sequence on Marvell
	  platforms using the device tree.

endmenu

config CPU_PXA168
	bool
	select COMMON_CLK
	select CPU_MOHAWK
	help
	  Select code specific to PXA168

config CPU_PXA910
	bool
	select COMMON_CLK
	select CPU_MOHAWK
	help
	  Select code specific to PXA910

config CPU_PXA988
	bool
	select CPU_V7
	select ARM_GIC
	select HAVE_SMP
	select HAVE_ARM_SCU
	select LOCAL_TIMERS
	select HAVE_ARM_TWD
	select COMMON_CLK
	select CLKSRC_OF
	select MIGHT_HAVE_CACHE_L2X0
	select ARM_HAS_SG_CHAIN
	select CORESIGHT_SUPPORT
	select CORESIGHT_TRACE_SUPPORT
	select ARCH_HAS_OPP
	help
	  Say 'Y' here if you want to support the Marvell pxa988-base
	  platforms.
	  PXA988 is an SoC with dual-core Cotex-A9 and comunication
	  processor, code name "Emei".

config CPU_PXA1928
	bool
	select CPU_CA7MP
	select COMMON_CLK
	select ARM_HAS_SG_CHAIN
	select CORESIGHT_SUPPORT
	select CORESIGHT_TRACE_SUPPORT
	select ARCH_HAS_OPP
	help
	  Support for PXA1928 processors based on the ARM Cortex-A7 MP CPU.
	  Select code specific to PXA1928

config CPU_PXA1986
	bool
	select CPU_CA7MP
	select COMMON_CLK
	select ARM_THUMBEE
	select HAVE_ARM_SCU
	select CLKSRC_OF
	select ARM_HAS_SG_CHAIN
	help
	  Say 'Y' here if you want to support the Marvell pxa1986-base
	  platforms.
	  PXA1986 is an SoC with dual-core Cortex-A15 and communication
	  processor, code name "Adir".

config CPU_CA7MP
	bool
	select CPU_V7
	select ARM_GIC
	select HAVE_SMP
	help
	  Select code specific to Cortex A7

config CPU_MMP2
	bool
	select COMMON_CLK
	select CPU_PJ4
	help
	  Select code specific to MMP2. MMP2 is ARMv7 compatible.

config TZ_HYPERVISOR
	bool "Enable TrustZone security feature"
	help
	  This option enables TrustZone security feature. With TrustZone
	  enabled, the kernel will run under non-secure state and access
	  secure resources via TZLC (TrustZone light calling).

config GPU_RESERVE_MEM
	bool "GC video memory allocator"
	default y
	help
	  reserve memory for GC as video memory

config PXA1928_ICU
	bool "support ICU features for EDEN SoC"
	default y
	depends on CPU_PXA1928 && !ARM64
	help
	  This option enables ICU support on PXA1928 SoC.
endif
```

## kernel/arch/arm/plat-pxa/Kconfig
```kconfig
if PLAT_PXA

config PXA_SSP
	tristate
	help
	  Enable support for PXA2xx SSP ports

config DUMP_REGS
       bool
       default n
       depends on (ARCH_PXA || ARCH_MMP)
       help
         Dump soc registers, stack, and possible functions in the stack
endif
```

## kernel/drivers/marvell/Kconfig
```kconfig
menuconfig MARVELL_DRIVERS
	bool "Marvell kernel module drivers"
	---help---
	marvell kernel module drivers

if MARVELL_DRIVERS

config MRVL_PANIC_FLUSH
        tristate "PXA cache flush when panic"
        depends on KEXEC
	default y
        ---help---
          Enable support for flush all cache during panic

config PXA_RAMDUMP
	bool "RAMDUMP debug capability"
	---help---
	RAMDUMP saves the information about CPU and SoC state and
	enables offline debug based on system RAM image (dump).
	Can be used indepentently, or with KEXEC.
	A memory map anchor structure RDC is used to store part
	of the error information, and provide references to
	extended information, where both can be located by an
	offline parser without kernel symbol table use.

config MRVL_SKMALLOC
	tristate "Marvell Supper Kmalloc Driver"
	default y
	---help---
	Create skmalloc-xxx like as kmalloc-xxx

config SKMALLOC_REBOOT_NOTIFY
	tristate "support changing skm_dbg_level by reboot cmd"
	depends on MRVL_SKMALLOC && KEXEC
	default y
	---help---
	If you want, you can change skm_dbg_level by reboot cmd,
	like "reboot skm_dbg_level=2".

config MRVL_SKMALLOC_WIRELESS_EN
	tristate "marvell wireless driver use skmalloc"
	depends on MRVL_SKMALLOC && MRVL_WIRELESS
	default y
	---help---
	Whether marvell wireless driver uses Supper Kmalloc or not

config MRVL_DEBUG
	tristate "Support Marvell debug features"
	default y
	---help---
	This will enable Marvell debug features.

config MRVL_LOG
	tristate "Support Marvell non-cacheable buffer"
	default y
	---help---
	  This will enable Marvell non-cacheable buffer shared between kernel and bootloader.

config MRVL_LOG_LAST_KMSG
        bool "Marvell Use Mrvl Log as Last Kmsg"
        depends on MRVL_LOG
        default y
        help
           This feature creats a node to read contents of mmp_log_buf
           area just before booting into kernel from bootloader.
           This is very helpful to read mmp_log_buf area without reset
           or entering upload mode.


config MRVL_WIRELESS
	bool "marvell wireless driver"
	---help---
	This enables the marvell wireless driver for application processor

choice
	depends on MRVL_WIRELESS
	bool "Choose the chip for marvell wireless"
	default MRVL_WL_SD8787_8777

config MRVL_WL_SD8XXX
	bool "SD8787/SD8777/SD8801/SD8887"
	---help---
	Marvell combo driver support: SD8787/SD8777/SD8801/SD8887 chips

config MRVL_WL_SD8897
	bool "SD8897"
	---help---
	Temporarily maintain SD8897 specifically, this item will be
	removed when Marvell combo driver support SD8897

endchoice

config MRVL_WL_BUILD_TYPE
	depends on MRVL_WL_SD8XXX || MRVL_WL_SD8897
	tristate "Build type of the driver for MARVELL wireless"
	default m
	---help---
	Choose <m> if you want to build the driver as module;
	<y> to build-in kernel; <n> if you do not want to build.

config MRVL_MMP_MODEM
       tristate "Marvell mmp modem driver"
       default n
       help
               marvell mmp modem driver for communication processor

config MRVL_MMP_MODEM_V2
       tristate "Marvell mmp modem v2 driver"
       default n
       help
               marvell mmp modem v2 driver for communication processor

config MRVL_GEU
       tristate "Marvell driver for generic encrypt unit"
       default n
       help
               driver for generic encrypt unit

config MRVL_TZDD
       tristate "Marvell Trust Zone Device Driver"
       default n
       help
               Marvell Trust Execution Environment (TEE) Solution in non-trusted world

config MRVL_MMP_CM3
       tristate "Marvell CM3 resource manager driver"
       default n
       help
               Marvell CM3 resource manager driver for PXA1U88

config MRVL_SW_JTAG
       tristate "Marvell software jtag driver"
       default n
       help
               Marvell software jtag driver to simulate jtag access

config MRVL_TDM
       tristate "Marvell Trusted Diagnostic Module driver"
       default n
       help
               Marvell TDM driver to kick tdm watchdog timer periodically
endif
```

## kernel/drivers/media/i2c/b52_camera/Kconfig
```kconfig
comment "b52_camera sensor drivers"

config B52_CAMERA_OV5642
	tristate "OV5642 camera support"
	depends on VIDEO_MMPISP_B52 && I2C
	help
	  This is a V4L2 camera driver for the ov5642 sensor

config B52_CAMERA_OV13850
	tristate "OV13850 camera support"
	depends on VIDEO_MMPISP_B52 && I2C
	help

config B52_CAMERA_OV13850R2A
tristate "OV13850R2A camera support"
    depends on VIDEO_MMPISP_B52 && I2C
    help
      This is a V4L2 camera driver for OV13850R2A sensor

config B52_CAMERA_IMX219
	tristate "imx219 camera support"
	depends on VIDEO_MMPISP_B52 && I2C
	help
	  This is a V4L2 camera driver for the imx219 sensor

config B52_CAMERA_OV5648
       tristate "OV5648 camera support"
       depends on VIDEO_MMPISP_B52 && I2C
       help
        This is a V4L2 camera driver for the ov5648 sensor

config B52_CAMERA_OV2680
       tristate "OV2680 camera support"
       depends on VIDEO_MMPISP_B52 && I2C
       help
        This is a V4L2 camera driver for the ov2680 sensor

config B52_CAMERA_OV8858R1A
	tristate "OV8858R1A camera support"
	depends on VIDEO_MMPISP_B52 && I2C
	help
	 This is a V4L2 camera driver for the ov8858r1a sensor
	 There're two versions of OV8858, one is OV8858R1A, another is
	 OV8858R2A. We can identify they by reading the register 0x302a,
	 if the value is 0xb1, it is the OV8858R1A, if the value is 0xb2,
	 the value is OV8858R2A.

config B52_CAMERA_OV8858R2A
	tristate "OV8858R2A camera support"
	depends on VIDEO_MMPISP_B52 && I2C
	help
	 This is a V4L2 camera driver for the ov8858r2a sensor

config B52_CAMERA_S5K5E3
    tristate "Samsung S5K5E3 camera support"
    depends on VIDEO_MMPISP_B52 && I2C
    help
     This is a V4L2 camera driver for the S5K5E3 sensor

config B52_CAMERA_S5K5E2
    tristate "Samsung S5K5E2 camera support"
    depends on VIDEO_MMPISP_B52 && I2C
    help
     This is a V4L2 camera driver for the S5K5E2 sensor

config B52_CAMERA_OV5670AF
	tristate "OV5670 camera support"
	depends on VIDEO_MMPISP_B52 && I2C
	help
	 This is a V4L2 camera driver for the ov5670 sensor
	 There're two modules of OV5670, AF module factory is SUNNY , FF module factory
	 is OFILM. We can identify they by reading the i2c addr,
	 if the value is 0x10, it is the FF OFILM module, if the value is 0x36,
	 it is the AF SUNNY module.

config B52_CAMERA_OV5670FF
	tristate "OV5670 camera support"
	depends on VIDEO_MMPISP_B52 && I2C
	help
	 This is a V4L2 camera driver for the ov5670 sensor

config B52_CAMERA_OV2740
    tristate "Ovt OV2740 camera support"
    depends on VIDEO_MMPISP_B52 && I2C
    help
     This is a V4L2 camera driver for the OV2740 sensor
```
